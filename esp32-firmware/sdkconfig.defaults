## esp32-firmware/sdkconfig.defaults
```kconfig
# Matter + ESP32-C6 Thread 默认配置 (XIAO ESP32-C6, 4MB Flash)
# C6 支持 Wi-Fi + BLE + 802.15.4 三模，可做 Thread 终端或 Border Router

# 目标芯片
CONFIG_IDF_TARGET="esp32c6"

# Flash 配置 (4MB)
CONFIG_ESPTOOLPY_FLASHSIZE_4MB=y
CONFIG_ESPTOOLPY_FLASHSIZE="4MB"

# 分区表
CONFIG_PARTITION_TABLE_CUSTOM=y
CONFIG_PARTITION_TABLE_CUSTOM_FILENAME="partitions.csv"
CONFIG_PARTITION_TABLE_FILENAME="partitions.csv"

# 启用 Matter
CONFIG_ENABLE_MATTER=y

# Thread / 802.15.4 (C6 三模支持)
CONFIG_OPENTHREAD_ENABLED=y

# Wi-Fi (保留，用于 Matter 配网阶段)
CONFIG_ESP_WIFI_STA_DISCONNECTED_PM_ENABLE=y

# BLE (用于 Matter 配网)
CONFIG_BT_ENABLED=y
CONFIG_BT_NIMBLE_ENABLED=y

# 内存优化
CONFIG_ESP_MAIN_TASK_STACK_SIZE=8192
CONFIG_ESP_SYSTEM_EVENT_TASK_STACK_SIZE=2048

# 日志级别
CONFIG_LOG_DEFAULT_LEVEL_INFO=y

# OTA
CONFIG_ESP_MATTER_ENABLE_OTA_REQUESTOR=y

# C6 特有优化
CONFIG_ESP_DEFAULT_CPU_FREQ_MHZ_160=y
CONFIG_ESP_INT_WDT_TIMEOUT_MS=1000

# mbedtls HKDF (Matter 依赖)
CONFIG_MBEDTLS_HKDF_C=y
```
